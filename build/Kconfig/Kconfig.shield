## build/Kconfig/Kconfig.shield
```kconfig
osource "c:/ncs/bt-fund-main/lesson1/blefund_less1_exer1/boards/shields/*/Kconfig.shield"
osource "c:/ncs/ble_beacon/boards/shields/*/Kconfig.shield"
osource "C:/ncs/v2.7.0/nrf/boards/shields/*/Kconfig.shield"
```

## build/Kconfig/Kconfig.shield.defconfig
```kconfig
osource "c:/ncs/bt-fund-main/lesson1/blefund_less1_exer1/boards/shields/*/Kconfig.defconfig"
osource "c:/ncs/ble_beacon/boards/shields/*/Kconfig.defconfig"
osource "C:/ncs/v2.7.0/nrf/boards/shields/*/Kconfig.defconfig"
```
